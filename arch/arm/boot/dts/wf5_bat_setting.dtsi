/*
 * Copyright (C) 2016 MediaTek Inc.
 *
 * This program is free software; you can redistribute it and/or modify
 * it under the terms of the GNU General Public License version 2 as
 * published by the Free Software Foundation.
 *
 * This program is distributed in the hope that it will be useful,
 * but WITHOUT ANY WARRANTY; without even the implied warranty of
 * MERCHANTABILITY or FITNESS FOR A PARTICULAR PURPOSE.
 * See http://www.gnu.org/licenses/gpl-2.0.html for more details.
 */

/*************************
 * Customized Battery Setting dtsi file
*************************/
&bat_comm {
			stop_charging_in_takling = <0x1>;
			talking_recharge_voltage = <0xed8>;
			talking_sync_time = <0x3c>;
			mtk_temperature_recharge_support = <0x1>;
			max_charge_temperature = <0x46>;
			max_charge_temperature_minus_x_degree = <0x41>;
			min_charge_temperature = <0x0>;
			min_charge_temperature_plus_x_degree = <0x6>;
			err_charge_temperature = <0xff>;
			v_pre2cc_thres = <0xd48>;
			v_cc2topoff_thres = <0x1040>;
			recharging_voltage = <0x107c>;
			charging_full_current = <0x64>;
			config_usb_if = <0x0>;
			usb_charger_current_suspend = <0x0>;
			usb_charger_current_unconfigured = <0x1b58>;
			usb_charger_current_configured = <0xc350>;
			usb_charger_current = <0xc350>;
			ac_charger_current = <0x186a0>;
			non_std_ac_charger_current = <0x186a0>;
			charging_host_charger_current = <0xfde8>;
			apple_0_5a_charger_current = <0xc350>;
			apple_1_0a_charger_current = <0xfde8>;
			apple_2_1a_charger_current = <0x13880>;
			bat_low_temp_protect_enable = <0x0>;
			v_charger_enable = <0x0>;
			v_charger_max = <0x1964>;
			v_charger_min = <0x1130>;
			onehundred_percent_tracking_time = <0xa>;
			npercent_tracking_time = <0x14>;
			sync_to_real_tracking_time = <0x3c>;
			v_0percent_tracking = <0xdde>;
			high_battery_voltage_support = <0x1>;
};

&bat_meter {
	/* cust_battery_meter.h */
	/* ADC resistor  */
	r_bat_sense = <4 >;
	r_i_sense = <4 >;
	r_charger_1 = <330 >;
	r_charger_2 = <39 >;
	temperature_t0 = <110 >;
	temperature_t1 = <0 >;
	temperature_t2 = <25 >;
	temperature_t3 = <50 >;
	temperature_t = <255 >;	/* this should be fixed, never change the value */
	fg_meter_resistance = <0 >;

	/* Qmax for 0mA */
			q_max_pos_50 = <0x1359>;
			q_max_pos_25 = <0x13ec>;
			q_max_pos_0 = <0x13b2>;
			q_max_neg_10 = <0x11e3>;
	/* Qmax for 400mA, said high current */
			q_max_pos_50_h_current = <0x132f>;
			q_max_pos_25_h_current = <0x13ba>;
			q_max_pos_0_h_current = <0x1279>;
			q_max_neg_10_h_current = <0xdd0>;
	/* Discharge percentage, 1: D5, 0: D2 */
			oam_d5 = <0x0>;

	change_tracking_point = <1 >;
	/* SW OCV tracking setting */
	cust_tracking_point = <0 >;
			cust_r_sense = <0xc8>;
	cust_hw_cc = <0 >;
	aging_tuning_value = <103 >;
	cust_r_fg_offset = <0 >;
	ocv_board_compesate = <0 >;
	r_fg_board_base = <1000 >;
	r_fg_board_slope = <1000 >;
			car_tune_value = <0x59>;

	/* HW Fuel gague  */
	current_detect_r_fg = <10 >;	/* Unit: mA */
	minerroroffset = <1000 >;
	fg_vbat_average_size = <18 >;
	r_fg_value = <10 >;	/* Unit: mOhm */

			cust_poweron_delta_capacity_tolrance = <0x1e>;
	cust_poweron_low_capacity_tolrance = <5 >;
	cust_poweron_max_vbat_tolrance = <90 >;
	cust_poweron_delta_vbat_tolrance = <30 >;
	cust_poweron_delta_hw_sw_ocv_capacity_tolrance = <10 >;

	/* Fixed battery temperature */
	fixed_tbat_25 = <0 >;

	/* Dynamic change wake up period of battery thread when suspend */
	vbat_normal_wakeup = <3600 >;	/* Unit: mV */
	vbat_low_power_wakeup = <3500 >;	/* Unit: mV */
	normal_wakeup_period = <5400 >;	/* Unit: second */
	low_power_wakeup_period = <300 >;	/* Unit: second */
	close_poweroff_wakeup_period = <30 >;	/* Unit: second */

	rbat_pull_up_r = <16900 >;
	rbat_pull_up_volt = <1800 >;

	batt_temperature_table_num = <19 >;
	batt_temperature_table = <
	    (-20) 68237
	    (-15) 53650
	    (-10) 42506
	    (-5) 33892
	    0 27219
	    5 22021
	    10 17926
	    15 14674
	    20 12081
	    25 10000
	    30 8315
	    35 6948
	    40 5834
	    45 4917
	    50 4161
	    55 3535
		60 3014
		65 2600
	    70 2250
	>;

			battery_profile_t0_num = <0x64>;
			battery_profile_t0 = <0x0 0x10e4 0x2 0x10c2 0x4 0x10a8 0x6 0x1091 0x8 0x107c 0x9 0x1068 0xb 0x1054 0xd 0x1041 0xf 0x102e 0x11 0x101b 0x13 0x1009 0x15 0xffa 0x17 0xfed 0x18 0xfd9 0x1a 0xfba 0x1c 0xf9a 0x1e 0xf83 0x20 0xf71 0x22 0xf63 0x24 0xf57 0x26 0xf4b 0x27 0xf3f 0x29 0xf32 0x2b 0xf26 0x2d 0xf1a 0x2f 0xf0f 0x31 0xf04 0x33 0xefb 0x35 0xef2 0x36 0xeeb 0x38 0xee3 0x3a 0xedd 0x3c 0xed7 0x3e 0xed1 0x40 0xecd 0x42 0xeca 0x44 0xec7 0x45 0xec5 0x47 0xec2 0x49 0xebf 0x4b 0xebc 0x4d 0xeb8 0x4f 0xeb4 0x51 0xeaf 0x53 0xea8 0x54 0xea1 0x56 0xe97 0x58 0xe8e 0x5a 0xe83 0x5c 0xe79 0x5e 0xe70 0x60 0xe68 0x61 0xe61 0x62 0xe5a 0x63 0xe50 0x64 0xdc8 0x64 0xdac 0x64 0xdac 0x64 0xdac 0x64 0xdac 0x64 0xdac 0x64 0xdac 0x64 0xdac 0x64 0xdac 0x64 0xdac 0x64 0xdac 0x64 0xdac 0x64 0xdac 0x64 0xdac 0x64 0xdac 0x64 0xdac 0x64 0xdac 0x64 0xdac 0x64 0xdac 0x64 0xdac 0x64 0xdac 0x64 0xdac 0x64 0xdac 0x64 0xdac 0x64 0xdac 0x64 0xdac 0x64 0xdac 0x64 0xdac 0x64 0xdac 0x64 0xdac 0x64 0xdac 0x64 0xdac 0x64 0xdac 0x64 0xdac 0x64 0xdac 0x64 0xdac 0x64 0xdac 0x64 0xdac 0x64 0xdac 0x64 0xdac 0x64 0xdac 0x64 0xdac 0x64 0xdac 0x64 0xdac 0x64 0xdac>;
			battery_profile_t1_num = <0x64>;
			battery_profile_t1 = <0x0 0x10e9 0x2 0x10cd 0x4 0x10b4 0x6 0x10a0 0x7 0x108c 0x9 0x1078 0xb 0x1065 0xd 0x1052 0xf 0x103f 0x11 0x102c 0x12 0x1018 0x14 0x1006 0x16 0xff5 0x18 0xfea 0x1a 0xfdc 0x1c 0xfbc 0x1e 0xf98 0x1f 0xf82 0x21 0xf72 0x23 0xf66 0x25 0xf5b 0x27 0xf4e 0x29 0xf3f 0x2b 0xf31 0x2c 0xf23 0x2e 0xf16 0x30 0xf0b 0x32 0xf01 0x34 0xef8 0x36 0xef0 0x37 0xee8 0x39 0xee2 0x3b 0xedb 0x3d 0xed5 0x3f 0xed0 0x41 0xecb 0x43 0xec7 0x44 0xec3 0x46 0xec0 0x48 0xebe 0x4a 0xeba 0x4c 0xeb7 0x4e 0xeb2 0x4f 0xead 0x51 0xea6 0x53 0xe9e 0x55 0xe93 0x57 0xe89 0x59 0xe7b 0x5b 0xe72 0x5c 0xe6e 0x5e 0xe69 0x60 0xe5c 0x62 0xe28 0x64 0xdbb 0x64 0xdac 0x64 0xdac 0x64 0xdac 0x64 0xdac 0x64 0xdac 0x64 0xdac 0x64 0xdac 0x64 0xdac 0x64 0xdac 0x64 0xdac 0x64 0xdac 0x64 0xdac 0x64 0xdac 0x64 0xdac 0x64 0xdac 0x64 0xdac 0x64 0xdac 0x64 0xdac 0x64 0xdac 0x64 0xdac 0x64 0xdac 0x64 0xdac 0x64 0xdac 0x64 0xdac 0x64 0xdac 0x64 0xdac 0x64 0xdac 0x64 0xdac 0x64 0xdac 0x64 0xdac 0x64 0xdac 0x64 0xdac 0x64 0xdac 0x64 0xdac 0x64 0xdac 0x64 0xdac 0x64 0xdac 0x64 0xdac 0x64 0xdac 0x64 0xdac 0x64 0xdac 0x64 0xdac 0x64 0xdac 0x64 0xdac 0x64 0xdac>;
			battery_profile_t2_num = <0x64>;
			battery_profile_t2 = <0x0 0x10f1 0x2 0x10d8 0x4 0x10c1 0x5 0x10ac 0x7 0x1097 0x9 0x1083 0xb 0x106e 0xd 0x105b 0xf 0x1047 0x10 0x1034 0x12 0x1021 0x14 0x100e 0x16 0xffb 0x18 0xfe9 0x19 0xfde 0x1b 0xfcf 0x1d 0xfb1 0x1f 0xf98 0x21 0xf8b 0x23 0xf84 0x24 0xf79 0x26 0xf6b 0x28 0xf5d 0x2a 0xf4c 0x2c 0xf37 0x2d 0xf24 0x2f 0xf16 0x31 0xf0a 0x33 0xf00 0x35 0xef7 0x37 0xeef 0x38 0xee8 0x3a 0xee1 0x3c 0xeda 0x3e 0xed5 0x40 0xecf 0x41 0xeca 0x43 0xec6 0x45 0xec1 0x47 0xebc 0x49 0xeb5 0x4b 0xead 0x4c 0xea8 0x4e 0xea1 0x50 0xe9b 0x52 0xe96 0x54 0xe8e 0x55 0xe83 0x57 0xe79 0x59 0xe6b 0x5b 0xe64 0x5d 0xe62 0x5f 0xe61 0x60 0xe58 0x62 0xe1b 0x64 0xdac 0x64 0xdac 0x64 0xdac 0x64 0xdac 0x64 0xdac 0x64 0xdac 0x64 0xdac 0x64 0xdac 0x64 0xdac 0x64 0xdac 0x64 0xdac 0x64 0xdac 0x64 0xdac 0x64 0xdac 0x64 0xdac 0x64 0xdac 0x64 0xdac 0x64 0xdac 0x64 0xdac 0x64 0xdac 0x64 0xdac 0x64 0xdac 0x64 0xdac 0x64 0xdac 0x64 0xdac 0x64 0xdac 0x64 0xdac 0x64 0xdac 0x64 0xdac 0x64 0xdac 0x64 0xdac 0x64 0xdac 0x64 0xdac 0x64 0xdac 0x64 0xdac 0x64 0xdac 0x64 0xdac 0x64 0xdac 0x64 0xdac 0x64 0xdac 0x64 0xdac 0x64 0xdac 0x64 0xdac 0x64 0xdac 0x64 0xdac>;
			battery_profile_t3_num = <0x64>;
			battery_profile_t3 = <0x0 0x10d9 0x2 0x10c2 0x4 0x10ad 0x6 0x1098 0x8 0x1083 0x9 0x106f 0xb 0x105a 0xd 0x1046 0xf 0x1033 0x11 0x101f 0x13 0x100c 0x15 0xff9 0x17 0xfe7 0x19 0xfd5 0x1a 0xfc4 0x1c 0xfb3 0x1e 0xfa2 0x20 0xf93 0x22 0xf83 0x24 0xf73 0x26 0xf63 0x28 0xf50 0x29 0xf3c 0x2b 0xf2a 0x2d 0xf1c 0x2f 0xf11 0x31 0xf06 0x33 0xefd 0x35 0xef4 0x37 0xeec 0x39 0xee4 0x3a 0xedd 0x3c 0xed7 0x3e 0xed0 0x40 0xecb 0x42 0xec6 0x44 0xec0 0x46 0xeba 0x48 0xeae 0x4a 0xea4 0x4b 0xe9d 0x4d 0xe95 0x4f 0xe8e 0x51 0xe89 0x53 0xe81 0x55 0xe76 0x57 0xe6c 0x59 0xe5f 0x5b 0xe59 0x5c 0xe58 0x5e 0xe56 0x60 0xe4d 0x62 0xe15 0x64 0xdb2 0x64 0xdac 0x64 0xdac 0x64 0xdac 0x64 0xdac 0x64 0xdac 0x64 0xdac 0x64 0xdac 0x64 0xdac 0x64 0xdac 0x64 0xdac 0x64 0xdac 0x64 0xdac 0x64 0xdac 0x64 0xdac 0x64 0xdac 0x64 0xdac 0x64 0xdac 0x64 0xdac 0x64 0xdac 0x64 0xdac 0x64 0xdac 0x64 0xdac 0x64 0xdac 0x64 0xdac 0x64 0xdac 0x64 0xdac 0x64 0xdac 0x64 0xdac 0x64 0xdac 0x64 0xdac 0x64 0xdac 0x64 0xdac 0x64 0xdac 0x64 0xdac 0x64 0xdac 0x64 0xdac 0x64 0xdac 0x64 0xdac 0x64 0xdac 0x64 0xdac 0x64 0xdac 0x64 0xdac 0x64 0xdac 0x64 0xdac 0x64 0xdac 0x64 0xdac>;
			r_profile_t0_num = <0x64>;
			r_profile_t0 = <0x351 0x10e4 0x351 0x10c2 0x34b 0x10a8 0x344 0x1091 0x334 0x107c 0x32b 0x1068 0x31f 0x1054 0x315 0x1041 0x30c 0x102e 0x301 0x101b 0x2f7 0x1009 0x2f4 0xffa 0x2f5 0xfed 0x2ed 0xfd9 0x2d0 0xfba 0x2b2 0xf9a 0x2a5 0xf83 0x29f 0xf71 0x29c 0xf63 0x29c 0xf57 0x296 0xf4b 0x28d 0xf3f 0x28d 0xf32 0x287 0xf26 0x283 0xf1a 0x27e 0xf0f 0x27e 0xf04 0x27e 0xefb 0x27e 0xef2 0x27e 0xeeb 0x281 0xee3 0x283 0xedd 0x286 0xed7 0x289 0xed1 0x28e 0xecd 0x295 0xeca 0x29f 0xec7 0x2af 0xec5 0x2bb 0xec2 0x2cb 0xebf 0x2da 0xebc 0x2ea 0xeb8 0x303 0xeb4 0x31b 0xeaf 0x337 0xea8 0x352 0xea1 0x379 0xe97 0x3a2 0xe8e 0x3d4 0xe83 0x67 0xe79 0x6e 0xe70 0x77 0xe68 0x78 0xe61 0x76 0xe5a 0x74 0xe50 0x335 0xdc8 0x335 0xdac 0x335 0xdac 0x335 0xdac 0x335 0xdac 0x335 0xdac 0x335 0xdac 0x335 0xdac 0x335 0xdac 0x335 0xdac 0x335 0xdac 0x335 0xdac 0x335 0xdac 0x335 0xdac 0x335 0xdac 0x335 0xdac 0x335 0xdac 0x335 0xdac 0x335 0xdac 0x335 0xdac 0x335 0xdac 0x335 0xdac 0x335 0xdac 0x335 0xdac 0x335 0xdac 0x335 0xdac 0x335 0xdac 0x335 0xdac 0x335 0xdac 0x335 0xdac 0x335 0xdac 0x335 0xdac 0x335 0xdac 0x335 0xdac 0x335 0xdac 0x335 0xdac 0x335 0xdac 0x335 0xdac 0x335 0xdac 0x335 0xdac 0x335 0xdac 0x335 0xdac 0x335 0xdac 0x335 0xdac 0x335 0xdac>;
			r_profile_t1_num = <0x64>;
			r_profile_t1 = <0x198 0x10e9 0x198 0x10cd 0x193 0x10b4 0x18d 0x10a0 0x186 0x108c 0x17e 0x1078 0x178 0x1065 0x173 0x1052 0x170 0x103f 0x16d 0x102c 0x169 0x1018 0x167 0x1006 0x166 0xff5 0x16d 0xfea 0x173 0xfdc 0x164 0xfbc 0x153 0xf98 0x14d 0xf82 0x149 0xf72 0x148 0xf66 0x147 0xf5b 0x13f 0xf4e 0x138 0xf3f 0x130 0xf31 0x12b 0xf23 0x128 0xf16 0x127 0xf0b 0x125 0xf01 0x126 0xef8 0x127 0xef0 0x128 0xee8 0x129 0xee2 0x12b 0xedb 0x12d 0xed5 0x12e 0xed0 0x130 0xecb 0x133 0xec7 0x137 0xec3 0x139 0xec0 0x138 0xebe 0x13c 0xeba 0x140 0xeb7 0x147 0xeb2 0x14c 0xead 0x154 0xea6 0x15c 0xe9e 0x166 0xe93 0x176 0xe89 0x188 0xe7b 0x19c 0xe72 0x1ba 0xe6e 0x1e6 0xe69 0x227 0xe5c 0x264 0xe28 0x2d7 0xdbb 0x2d7 0xdac 0x2d7 0xdac 0x2d7 0xdac 0x2d7 0xdac 0x2d7 0xdac 0x2d7 0xdac 0x2d7 0xdac 0x2d7 0xdac 0x2d7 0xdac 0x2d7 0xdac 0x2d7 0xdac 0x2d7 0xdac 0x2d7 0xdac 0x2d7 0xdac 0x2d7 0xdac 0x2d7 0xdac 0x2d7 0xdac 0x2d7 0xdac 0x2d7 0xdac 0x2d7 0xdac 0x2d7 0xdac 0x2d7 0xdac 0x2d7 0xdac 0x2d7 0xdac 0x2d7 0xdac 0x2d7 0xdac 0x2d7 0xdac 0x2d7 0xdac 0x2d7 0xdac 0x2d7 0xdac 0x2d7 0xdac 0x2d7 0xdac 0x2d7 0xdac 0x2d7 0xdac 0x2d7 0xdac 0x2d7 0xdac 0x2d7 0xdac 0x2d7 0xdac 0x2d7 0xdac 0x2d7 0xdac 0x2d7 0xdac 0x2d7 0xdac 0x2d7 0xdac 0x2d7 0xdac 0x2d7 0xdac>;
			r_profile_t2_num = <0x64>;
			r_profile_t2 = <0x7c 0x10f1 0x7c 0x10d8 0x7d 0x10c1 0x7b 0x10ac 0x7a 0x1097 0x7a 0x1083 0x7a 0x106e 0x7a 0x105b 0x79 0x1047 0x7b 0x1034 0x7d 0x1021 0x7c 0x100e 0x7c 0xffb 0x7c 0xfe9 0x85 0xfde 0x84 0xfcf 0x7d 0xfb1 0x7e 0xf98 0x80 0xf8b 0x88 0xf84 0x89 0xf79 0x8b 0xf6b 0x8d 0xf5d 0x8a 0xf4c 0x81 0xf37 0x7a 0xf24 0x77 0xf16 0x75 0xf0a 0x74 0xf00 0x74 0xef7 0x74 0xeef 0x75 0xee8 0x74 0xee1 0x73 0xeda 0x74 0xed5 0x74 0xecf 0x75 0xeca 0x76 0xec6 0x77 0xec1 0x77 0xebc 0x74 0xeb5 0x71 0xead 0x74 0xea8 0x74 0xea1 0x74 0xe9b 0x77 0xe96 0x76 0xe8e 0x76 0xe83 0x77 0xe79 0x77 0xe6b 0x74 0xe64 0x78 0xe62 0x81 0xe61 0x8c 0xe58 0x87 0xe1b 0x91 0xdac 0x91 0xdac 0x91 0xdac 0x91 0xdac 0x91 0xdac 0x91 0xdac 0x91 0xdac 0x91 0xdac 0x91 0xdac 0x91 0xdac 0x91 0xdac 0x91 0xdac 0x91 0xdac 0x91 0xdac 0x91 0xdac 0x91 0xdac 0x91 0xdac 0x91 0xdac 0x91 0xdac 0x91 0xdac 0x91 0xdac 0x91 0xdac 0x91 0xdac 0x91 0xdac 0x91 0xdac 0x91 0xdac 0x91 0xdac 0x91 0xdac 0x91 0xdac 0x91 0xdac 0x91 0xdac 0x91 0xdac 0x91 0xdac 0x91 0xdac 0x91 0xdac 0x91 0xdac 0x91 0xdac 0x91 0xdac 0x91 0xdac 0x91 0xdac 0x91 0xdac 0x91 0xdac 0x91 0xdac 0x91 0xdac 0x91 0xdac>;
			r_profile_t3_num = <0x64>;
			r_profile_t3 = <0x66 0x10d9 0x66 0x10c2 0x66 0x10ad 0x67 0x1098 0x67 0x1083 0x67 0x106f 0x66 0x105a 0x67 0x1046 0x67 0x1033 0x68 0x101f 0x68 0x100c 0x68 0xff9 0x69 0xfe7 0x6a 0xfd5 0x6c 0xfc4 0x6c 0xfb3 0x6d 0xfa2 0x70 0xf93 0x71 0xf83 0x73 0xf73 0x76 0xf63 0x74 0xf50 0x6d 0xf3c 0x69 0xf2a 0x67 0xf1c 0x68 0xf11 0x67 0xf06 0x67 0xefd 0x67 0xef4 0x66 0xeec 0x67 0xee4 0x68 0xedd 0x68 0xed7 0x69 0xed0 0x6a 0xecb 0x6c 0xec6 0x6d 0xec0 0x6d 0xeba 0x67 0xeae 0x68 0xea4 0x69 0xe9d 0x68 0xe95 0x67 0xe8e 0x6a 0xe89 0x6b 0xe81 0x69 0xe76 0x6b 0xe6c 0x67 0xe5f 0x66 0xe59 0x6d 0xe58 0x76 0xe56 0x7e 0xe4d 0x72 0xe15 0x77 0xdb2 0x89 0xdac 0x89 0xdac 0x89 0xdac 0x89 0xdac 0x89 0xdac 0x89 0xdac 0x89 0xdac 0x89 0xdac 0x89 0xdac 0x89 0xdac 0x89 0xdac 0x89 0xdac 0x89 0xdac 0x89 0xdac 0x89 0xdac 0x89 0xdac 0x89 0xdac 0x89 0xdac 0x89 0xdac 0x89 0xdac 0x89 0xdac 0x89 0xdac 0x89 0xdac 0x89 0xdac 0x89 0xdac 0x89 0xdac 0x89 0xdac 0x89 0xdac 0x89 0xdac 0x89 0xdac 0x89 0xdac 0x89 0xdac 0x89 0xdac 0x89 0xdac 0x89 0xdac 0x89 0xdac 0x89 0xdac 0x89 0xdac 0x89 0xdac 0x89 0xdac 0x89 0xdac 0x89 0xdac 0x89 0xdac 0x89 0xdac 0x89 0xdac 0x89 0xdac>;
};
